## meta-orca-bsp/conf/layer.conf
```bitbake
# We have a conf and classes directory, add to BBPATH
BBPATH .= ":${LAYERDIR}"

# We have recipes-* directories, add to BBFILES
BBFILES += "${LAYERDIR}/recipes-*/*/*.bb \
            ${LAYERDIR}/recipes-*/*/*.bbappend"

BBFILE_COLLECTIONS += "meta-orca-bsp"
BBFILE_PATTERN_meta-orca-bsp = "^${LAYERDIR}/"
BBFILE_PRIORITY_meta-orca-bsp = "6"

LAYERDEPENDS_meta-orca-bsp = "core stm-st-stm32mp"
LAYERSERIES_COMPAT_meta-orca-bsp = "scarthgap"
```

## meta-orca-bsp/conf/machine/tilikum.conf
```bitbake
MACHINEOVERRIDES =. "stm32mp1common:stm32mp13common:"

include conf/machine/include/st-machine-common-stm32mp.inc
include conf/machine/include/st-machine-providers-stm32mp.inc

# =========================================================================
# Chip architecture
# =========================================================================
DEFAULTTUNE = "cortexa7thf-neon-vfpv4"
include conf/machine/include/arm/armv7a/tune-cortexa7.inc

# =========================================================================
# boot scheme
# =========================================================================
BOOTSCHEME_LABELS += "optee"

# =========================================================================
# boot device
# =========================================================================
BOOTDEVICE_LABELS += "sdcard"

# =========================================================================
# Machine settings
# =========================================================================
STM32MP_DT_FILES_SDCARD += "stm32mp135f-dk"

# =========================================================================
# Machine features
# =========================================================================
MACHINE_FEATURES += "splashscreen watchdog bluetooth touchscreen"
MACHINE_FEATURES:remove = "usbhost usbgadget alsa screen ext2 pci fw-update qemu-usermode"

# Bluetooth
BLUETOOTH_LIST += "linux-firmware-addons-bcm43xx"
```

## meta-orca-distro/conf/distro/include/orca-configuration.inc
```bitbake
#security with CVE checks
include conf/distro/include/cve-extra-exclusions.inc

#no GPL v3
require conf/distro/include/no-gplv3.inc

#enhanced security flags
require conf/distro/include/security_flags.inc

OVERRIDES =. "${MNGR_SLCT}:"
INIT_MANAGER ="systemd"
INIT_MANAGER:sysd = "systemd"
INIT_MANAGER:sysv = "sysvinit"

#build information file
INHERIT += "image-buildinfo"
IMAGE_BUILDINFO_FILE = "${sysconfdir}/os-release"
TIMESTAMP = "${DATETIME}"
IMAGE_BUILDINFO_VARS = "DISTRO DISTRO_NAME DISTRO_VERSION IMAGE_NAME TIMESTAMP"
```

## meta-orca-distro/conf/distro/orca.conf
```bitbake
DISTRO = "orca"
DISTRO_NAME = " Orca Distribution "
DISTRO_VERSION = "1.0"
DISTRO_CODENAME = "scarthgap"
MAINTAINER = "bkhadhraoui870@gmail.com"

#extra config
include conf/distro/include/orca-configuration.inc

#Distribution features
DISTRO_FEATURES_BACKFILL_CONSIDERED = "${DISTRO_FEATURES_BACKFILL}"
DISTRO_FEATURES = "\
    acl \
    ${INIT_MANAGER} \
    bluetooth \
    wayland "
    
#Init Manager Selector "sysd" for Systemd/"sysv" for Sysvinit
MNGR_SLCT = "sysd"

#linux Utilities
VIRTUAL-RUNTIME_base-utils = ""

#Unique C Library
TCLIBC = "glibc"
TCLIBCAPPEND = ""

#Target
TARGET_OS = "linux-gnueabi"

#Package Type 
PACKAGE_CLASSES = "package_ipk"
```

## meta-orca-distro/conf/layer.conf
```bitbake
# We have a conf and classes directory, add to BBPATH
BBPATH .= ":${LAYERDIR}"

# We have recipes-* directories, add to BBFILES
BBFILES += "${LAYERDIR}/recipes-*/*/*.bb \
            ${LAYERDIR}/recipes-*/*/*.bbappend"

BBFILE_COLLECTIONS += "meta-orca-distro"
BBFILE_PATTERN_meta-orca-distro = "^${LAYERDIR}/"
BBFILE_PRIORITY_meta-orca-distro = "6"

LAYERDEPENDS_meta-orca-distro = "core"
LAYERSERIES_COMPAT_meta-orca-distro = "scarthgap"
```

## meta-orca-prj/conf/layer.conf
```bitbake
# We have a conf and classes directory, add to BBPATH
BBPATH .= ":${LAYERDIR}"

# We have recipes-* directories, add to BBFILES
BBFILES += "${LAYERDIR}/recipes-*/*/*.bb \
            ${LAYERDIR}/recipes-*/*/*.bbappend"

BBFILE_COLLECTIONS += "meta-orca-prj"
BBFILE_PATTERN_meta-orca-prj = "^${LAYERDIR}/"
BBFILE_PRIORITY_meta-orca-prj = "6"

LAYERDEPENDS_meta-orca-prj = "core"
LAYERSERIES_COMPAT_meta-orca-prj = "scarthgap"
```
